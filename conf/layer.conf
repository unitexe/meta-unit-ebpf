## conf/layer.conf
```bitbake
BBPATH .= ":${LAYERDIR}"

BBFILES += "${LAYERDIR}/recipes*/*/*.bb ${LAYERDIR}/recipes*/*/*.bbappend"

BBFILE_COLLECTIONS += "meta-unit-ebpf"
BBFILE_PATTERN_meta-unit-ebpf := "^${LAYERDIR}/"
BBFILE_PRIORITY_meta-unit-ebpf = "13"

LAYERDEPENDS_meta-unit-ebpf = "core clang-layer"

LAYERSERIES_COMPAT_meta-unit-ebpf = "scarthgap styhead walnascar"

UNIT_EBPF_LAYERDIR = "${LAYERDIR}"

BBFILES_DYNAMIC += " \
    freescale-layer:${LAYERDIR}/dynamic-layers/freescale-layer/*/*/*.bb \
    freescale-layer:${LAYERDIR}/dynamic-layers/freescale-layer/*/*/*.bbappend \
    raspberrypi:${LAYERDIR}/dynamic-layers/raspberrypi/*/*/*.bb \
    raspberrypi:${LAYERDIR}/dynamic-layers/raspberrypi/*/*/*.bbappend \
"
```
